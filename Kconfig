## Kconfig
```kconfig
menuconfig RT_USING_NIMBLE
    bool "NimBLE: Apache NimBLE is an open-source Bluetooth 5.4 stack"
    select RT_USING_MESSAGEQUEUE
    default n

if RT_USING_NIMBLE

    menuconfig RT_NIMBLE_HCI_TRANSPORT
            bool "HCI Transport support"
            default y

    if RT_NIMBLE_HCI_TRANSPORT
        choice
            prompt "HCI Transport using"
            default RT_NIMBLE_HCI_USING_RTT_UART

            config RT_NIMBLE_HCI_USING_RTT_VHCI
                bool "HCI Transport using rt-thread vhci devices"

            config RT_NIMBLE_HCI_USING_RTT_UART
                bool "HCI Transport using rt-thread serial devices"

            config RT_NIMBLE_HCI_USING_CUSTOM_IMPL
                bool "HCI Transport using custom implementation"
        endchoice

        if RT_NIMBLE_HCI_USING_RTT_UART
            config RT_NIMBLE_HCI_UART_DEVICE_NAME
                string "The uart for HCI Transport"
                default "uart1"
            config RT_NIMBLE_HCI_UART_FLOWCONTROL_CTSRTS
                bool "Enable uart flowcontrol CTS/RTS"
                default n
        endif

        if RT_NIMBLE_HCI_USING_RTT_VHCI
            config RT_NIMBLE_VHCI_DEVICE_NAME
                string "The vhci device for HCI Transport"
                default "vhci"
        endif
    endif # RT_NIMBLE_HCI_TRANSPORT

    menu "Host Stack Configuration"
        config RT_NIMBLE_HOST
        bool "Bluetooth Host Stack support"
        default y

        if RT_NIMBLE_HOST

        config RT_NIMBLE_HOST_THREAD_STACK_SIZE
        int "The thread stack Size of Host Stack"
        default 1536
        help
            Set Host thread stack size.

        config RT_NIMBLE_HOST_THREAD_PRIORITY
        int "The thread priority of Host Stack"
        default 8
        help
            Set Host Stack thread priority.

        endif
    endmenu # Host Stack Configuration

    menu "Bluetooth Role support"

        config RT_NIMBLE_ROLE_PERIPHERAL
        bool "Peripheral Role support"
        select RT_NIMBLE_ROLE_BROADCASTER
        default y
        help
            Select this for LE Peripheral role support.

        config RT_NIMBLE_ROLE_CENTRAL
        bool "Central Role support"
        select RT_NIMBLE_ROLE_OBSERVER
        default y
        help
            Select this for LE Central role support.

        config RT_NIMBLE_ROLE_BROADCASTER
        bool "Broadcaster Role support"
        default y
        help
            Select this for LE Broadcaster role support.

        config RT_NIMBLE_ROLE_OBSERVER
        bool "Observer Role support"
        help
            Select this for LE Observer role support.
    endmenu # Bluetooth Role support

    menu "Bluetooth Mesh support"
        config RT_NIMBLE_MESH
        bool "Bluetooth Mesh support"
        default n
        depends on RT_NIMBLE_ROLE_BROADCASTER && RT_NIMBLE_ROLE_OBSERVER
        help
            This option enables Bluetooth Mesh support. The specific
            features that are available may depend on other features
            that have been enabled in the stack, such as GATT support.

        if RT_NIMBLE_MESH
            config RT_NIMBLE_MESH_DEVICE_NAME
                string "BLE Mesh device/node name"
                default "nimble-node"
                help
                    This value defines BLE Mesh device/node name.

            config RT_NIMBLE_MESH_ADV_THREAD_STACK_SIZE
                int "The thread stack Size of Mesh advertising"
                default 1024
                help
                    Set Mesh advertising thread stack size.

            config RT_NIMBLE_MESH_ADV_THREAD_PRIORITY
                int "The thread priority of Mesh Advertising"
                default 9
                help
                    Set Mesh Advertising thread priority.

            config RT_NIMBLE_MESH_CFG_CLI
                bool "Support for Configuration Client Model"
                help
                    Enable support for the configuration client model.
        endif # RT_NIMBLE_MESH

    endmenu # Bluetooth Mesh support

    config RT_NIMBLE_MAX_CONNECTIONS
        int "Maximum number of concurrent connections"
        range 1 32
        default 1
        help
            Maximum number of concurrent Bluetooth connections supported.

    config RT_NIMBLE_WHITELIST
        bool "Device Whitelist Support"
        default y
        help
            Enables the BLE whitelist for controlling who to connect to
            oraccept a connection from.

    config RT_NIMBLE_MULTI_ADV_INSTANCES
        int "The number of multi-advertising instances"
        default 0
        depends on RT_NIMBLE_ROLE_BROADCASTER
        help
            This is the number of multi-advertising instances. This is NOT
            the total number of advertising instances. The total number of
            advertising instances is this number plus 1.

    config RT_NIMBLE_EXT_ADV
        bool "Extended Advertising Feature Support"
        default n
        depends on RT_NIMBLE_ROLE_BROADCASTER
        help
            This enables extended advertising feature.

    config RT_NIMBLE_EXT_ADV_MAX_SIZE
        int "The number of multi-advertising instances"
        range 31 1650
        default 31
        depends on RT_NIMBLE_EXT_ADV
        help
            This allows to configure maximum size of advertising data and scan
            response data used in LE Advertising Extensions. Valid range 31-1650.

    choice
        prompt "Log level"
        default NIMBLE_DEBUG_LEVEL_I
        help
            select the NIMBLE log level

        config NIMBLE_DEBUG_LEVEL_O
            bool "OFF"

        config NIMBLE_DEBUG_LEVEL_E
            bool "ERROR"

        config NIMBLE_DEBUG_LEVEL_W
            bool "WARING"

        config NIMBLE_DEBUG_LEVEL_I
            bool "INFO"

        config NIMBLE_DEBUG_LEVEL_D
            bool "DEBUG"
    endchoice

    config NIMBLE_DEBUG_LEVEL
        # Virtual/hidden option
        int
        default -1 if NIMBLE_DEBUG_LEVEL_O
        default 0 if NIMBLE_DEBUG_LEVEL_E
        default 1 if NIMBLE_DEBUG_LEVEL_W
        default 2 if NIMBLE_DEBUG_LEVEL_I
        default 3 if NIMBLE_DEBUG_LEVEL_D
        default 2

endif # RT_USING_NIMBLE
```
